## buildroot/configs/pixie2_defconfig
```kconfig
BR2_x86_64=y
BR2_TOOLCHAIN_BUILDROOT_MUSL=y
BR2_KERNEL_HEADERS_5_17=y
BR2_TOOLCHAIN_BUILDROOT_CXX=y
BR2_DL_DIR="$(TOPDIR)/../dl"
BR2_PER_PACKAGE_DIRECTORIES=y
BR2_TARGET_GENERIC_HOSTNAME="pixie-image"
BR2_TARGET_GENERIC_ISSUE="Pixie debug shell"
BR2_ROOTFS_OVERLAY="$(BR2_EXTERNAL_PIXIE2_PATH)/rootfs-overlay"
BR2_LINUX_KERNEL=y
BR2_LINUX_KERNEL_USE_CUSTOM_CONFIG=y
BR2_LINUX_KERNEL_CUSTOM_CONFIG_FILE="$(BR2_EXTERNAL_PIXIE2_PATH)/linux_config"
BR2_LINUX_KERNEL_ZSTD=y
BR2_PACKAGE_BUSYBOX_SHOW_OTHERS=y
BR2_PACKAGE_E2FSPROGS=y
# BR2_PACKAGE_E2FSPROGS_FSCK is not set
BR2_PACKAGE_ZLIB=y
BR2_PACKAGE_ZLIB_NG=y
BR2_PACKAGE_DHCPCD=y
BR2_PACKAGE_ETHTOOL=y
# BR2_PACKAGE_ETHTOOL_PRETTY_PRINT is not set
# BR2_PACKAGE_IFUPDOWN_SCRIPTS is not set
BR2_PACKAGE_IPROUTE2=y
BR2_PACKAGE_TINYSSH=y
# BR2_PACKAGE_URANDOM_SCRIPTS is not set
BR2_PACKAGE_BASH=y
BR2_PACKAGE_EFIBOOTMGR=y
BR2_PACKAGE_NANO=y
BR2_TARGET_ROOTFS_CPIO_ZSTD=y
BR2_TARGET_ROOTFS_INITRAMFS=y
# BR2_TARGET_ROOTFS_TAR is not set
BR2_PACKAGE_HOST_PKGCONF=y
BR2_PACKAGE_PIXIE_CLIENT=y
```

## buildroot/package/efivar38/Config.in
```kconfig
config BR2_PACKAGE_EFIVAR38
	bool "efivar38"
	depends on BR2_PACKAGE_EFIVAR_ARCH_SUPPORTS
	depends on !BR2_STATIC_LIBS # dlfcn.h
	depends on BR2_TOOLCHAIN_HEADERS_AT_LEAST_3_12 # linux/nvme.h
	# linux/nvme.h has been renamed to linux/nvme_ioctl.h since 4.4,
	# and the efivar source handles that situation. However, some
	# Sourcery CodeBench toolchains use 4.4 kernel headers but they
	# don't have that header file renamed, and that is causing build
	# failures. So, prevent this package to be built using those
	# toolchains.
	depends on !BR2_TOOLCHAIN_EXTERNAL_CODESOURCERY_MIPS
	depends on BR2_TOOLCHAIN_GCC_AT_LEAST_4_9
	help
	  Tools and libraries to manipulate EFI variables

	  https://github.com/rhboot/efivar


comment "efivar needs a toolchain w/ dynamic library, headers >= 3.12, gcc >= 4.9"
	depends on BR2_PACKAGE_EFIVAR_ARCH_SUPPORTS
	depends on BR2_STATIC_LIBS || \
		!BR2_TOOLCHAIN_HEADERS_AT_LEAST_3_12 || \
		!BR2_TOOLCHAIN_GCC_AT_LEAST_4_9
	depends on !BR2_TOOLCHAIN_EXTERNAL_CODESOURCERY_MIPS

# adapted from buildroot's config.
```

## buildroot/package/pixie-client/Config.in
```kconfig
config BR2_PACKAGE_PIXIE_CLIENT
    bool "pixie_client"
    depends on BR2_PACKAGE_HOST_RUSTC_TARGET_ARCH_SUPPORTS
    depends on BR2_PACKAGE_HOST_PKGCONF
    select BR2_PACKAGE_HOST_RUSTC
    help
      Fetch images.
```

## buildroot/package/pixie-pull/Config.in
```kconfig
config BR2_PACKAGE_PIXIE_PULL
    bool "pixie_pull"
    depends on BR2_PACKAGE_HOST_RUSTC_TARGET_ARCH_SUPPORTS
    depends on BR2_PACKAGE_HOST_PKGCONF
    depends on BR2_PACKAGE_LIBOPENSSL
    select BR2_PACKAGE_HOST_RUSTC
    help
      Fetch images.
```

## buildroot/package/pixie-register/Config.in
```kconfig
config BR2_PACKAGE_PIXIE_REGISTER
    bool "pixie_register"
    depends on BR2_PACKAGE_HOST_RUSTC_TARGET_ARCH_SUPPORTS
    depends on BR2_PACKAGE_HOST_PKGCONF
    depends on BR2_PACKAGE_LIBOPENSSL
    select BR2_PACKAGE_HOST_RUSTC
    help
      Register machine.
```
